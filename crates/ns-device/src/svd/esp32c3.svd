# ESP32-C3 register map
Vendor: Espressif Systems
CPU: RISC-V
Registers are 32-bit, access not given, reset 0x0 unless marked. A register's access mark holds for its fields unless they carry their own. Offsets are from the block's base; lines under a group give offsets from that group; [hi:lo] are bit positions; {n}, {i} and the like mark numbered series; 'fields as' and 'values as' point back to an identical list; <NAME> marks a mode.

## Memory map
0x60003000 SPI0 — SPI controller
0x60004000 GPIO — General purpose I/O
0x60008000 RTC_TIMER
0x6000F000 UART0 — Universal asynchronous receiver/transmitter

## GPIO — General purpose I/O
Base 0x60004000
0x04 OUT — Output
0x08 OUT_W1TS — Output set
0x0C OUT_W1TC — Output clear
0x10 IN — Input
0x20 ENABLE

## UART0 — Universal asynchronous receiver/transmitter
Base 0x6000F000
0x00 CONF0 — Configuration
0x04 FIFO — Data FIFO
0x10 INT_ENA — Interrupt enable
0x18 CLKDIV — Clock divider

## SPI0 — SPI controller
Base 0x60003000
0x00 CMD — Command
0x04 ADDR — Address
0x10 USER — User config

## RTC_TIMER
Base 0x60008000
0x00 TIME_LOW
0x04 TIME_HIGH
