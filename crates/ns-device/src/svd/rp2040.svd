# RP2040 register map
Vendor: Raspberry Pi
CPU: CM0PLUS
Registers are 32-bit, access not given, reset 0x0 unless marked. A register's access mark holds for its fields unless they carry their own. Offsets are from the block's base; lines under a group give offsets from that group; [hi:lo] are bit positions; {n}, {i} and the like mark numbered series; 'fields as' and 'values as' point back to an identical list; <NAME> marks a mode.

## Memory map
0x40008000 CLOCKS — Clock control
0x4000C000 RESETS — Reset control
0x40034000 UART0 — Universal asynchronous receiver/transmitter
0x40044000 I2C0 — I2C controller 0
0x50200000 PIO0 — Programmable I/O 0

## RESETS — Reset control
Base 0x4000C000
0x00 RESET
0x08 RESET_DONE

## CLOCKS — Clock control
Base 0x40008000
0x2C CLK_SYS_CTRL — System clock control
0x44 CLK_PERI_CTRL — Peripheral clock control

## PIO0 — Programmable I/O 0
Base 0x50200000
0x00 CTRL — Control
0x04 FSTAT — FIFO status
0x08 FLEVEL — FIFO level
0x10 TXF — FIFO write
0x14 RXF — FIFO read

## UART0 — Universal asynchronous receiver/transmitter
Base 0x40034000
0x00 DR — Data
0x18 FR — Flag
0x24 IBRD — Integer baud rate
0x28 FBRD — Fractional baud rate
0x2C LCR_H — Line control
0x30 CR — Control

## I2C0 — I2C controller 0
Base 0x40044000
0x00 CON — Control
0x10 DATA_CMD — Data/command
0x14 FS_SCL_HCNT — Fast mode SCL high count
0x18 FS_SCL_LCNT — Fast mode SCL low count
