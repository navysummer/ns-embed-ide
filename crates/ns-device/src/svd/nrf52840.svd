# nRF52840 register map
Vendor: Nordic Semiconductor
CPU: CM4
Registers are 32-bit, access not given, reset 0x0 unless marked. A register's access mark holds for its fields unless they carry their own. Offsets are from the block's base; lines under a group give offsets from that group; [hi:lo] are bit positions; {n}, {i} and the like mark numbered series; 'fields as' and 'values as' point back to an identical list; <NAME> marks a mode.

## Memory map
0x40000000 POWER — Power supply
0x40000000 CLOCK — Clock control
0x40002000 UARTE0 — Universal asynchronous receiver/transmitter with EasyDMA
0x40008000 TIMER0 — General purpose timer
0x50000000 GPIO — General purpose I/O

## POWER — Power supply
Base 0x40000000
0x78 TASKS_CONSTLAT — Enable constant latency
0x108 EVENTS_POFWARN — Power-on warning
0x500 SYSTEMOFF

## CLOCK — Clock control
Base 0x40000000
0x00 TASKS_HFCLKSTART — Start HFCLK
0x04 HFCLKSTAT — HFCLK status

## GPIO — General purpose I/O
Base 0x50000000
0x504 OUT — Output
0x508 OUTSET — Output set
0x50C OUTCLR — Output clear
0x510 IN — Input
0x514 DIR — Direction

## UARTE0 — Universal asynchronous receiver/transmitter with EasyDMA
Base 0x40002000
0x00 TASKS_STARTRX — Start RX
0x08 TASKS_STARTTX — Start TX
0x500 ENABLE
0x524 BAUDRATE

## TIMER0 — General purpose timer
Base 0x40008000
0x00 TASKS_START — Start
0x04 TASKS_STOP — Stop
0x510 PRESCALER
0x540 CC[0] — Capture/compare 0
